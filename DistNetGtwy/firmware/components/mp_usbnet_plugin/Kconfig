## DistNetGtwy/firmware/components/mp_usbnet_plugin/Kconfig
```kconfig
menu "MicroPython USB Network Plugin"

config MP_USBNET_DEFAULT_HOSTNAME
    string "Default mDNS hostname"
    default "mesh-gateway"

config MP_USBNET_DEFAULT_IP
    string "Default device IPv4"
    default "192.168.137.2"

config MP_USBNET_DEFAULT_NETMASK
    string "Default netmask"
    default "255.255.255.0"

config MP_USBNET_DEFAULT_GATEWAY
    string "Default gateway/host IPv4"
    default "192.168.137.1"

endmenu
```
